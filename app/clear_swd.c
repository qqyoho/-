#include "clear_swd.h"

#define CLEAR_SWD_TIME        5

uint8_t g_clear_swd_flag;
static volatile uint16_t t_clear_swd_time;

/*=============================================================
* 函数名称：clear_swd_mem_init
* 函数功能：清除SWD接口
* 参数个数：0
* 参数描述：
* 返 回 值：无
* 修改记录：
*===============================================================
* 日    期          修改人      修改类型
* 2018-10-31       	戴辉发     	创建
==============================================================*/
void clear_swd_mem_init(void)
{
	t_clear_swd_time = CLEAR_SWD_TIME;
    g_clear_swd_flag = 1;
}

/*=============================================================
* 函数名称：clear_swd_1s_timer_process
* 函数功能：SWD功能清除定时器
* 参数个数：0
* 参数描述：
* 返 回 值：无
* 修改记录：
*===============================================================
* 日    期          修改人      修改类型
* 2018-10-31       	戴辉发     	创建
==============================================================*/
void clear_swd_1s_timer_process(void)
{
    if (t_clear_swd_time) t_clear_swd_time --;
}

/*=============================================================
* 函数名称：clear_swd_function
* 函数功能：清除SWD功能
* 参数个数：0
* 参数描述：
* 返 回 值：无
* 修改记录：
*===============================================================
* 日    期          修改人      修改类型
* 2018-10-31       	戴辉发     	创建
==============================================================*/
static void clear_swd_function(void)
{
#if !defined (NEGT_DEBUG)
    gpio_init(GPIOA, GPIO_MODE_IPD, GPIO_OSPEED_2MHZ, GPIO_PIN_13 | GPIO_PIN_14);  
#endif
}

/*=============================================================
* 函数名称：set_swd_function
* 函数功能：设置SWD功能
* 参数个数：0
* 参数描述：
* 返 回 值：无
* 修改记录：
*===============================================================
* 日    期          修改人      修改类型
* 2018-10-31       	戴辉发     	创建
==============================================================*/
static void set_swd_function(void)
{
    
}

/*=============================================================
* 函数名称：config_swd_function
* 函数功能：配置SWD功能
* 参数个数：0
* 参数描述：
* 返 回 值：无
* 修改记录：
*===============================================================
* 日    期          修改人      修改类型
* 2018-10-31       	戴辉发     	创建
==============================================================*/
void config_swd_function(void)
{
	if (g_clear_swd_flag)
    {
        set_swd_function();
    }
    else
    {
        clear_swd_function();
    }
}

/*=============================================================
* 函数名称：swd_process
* 函数功能：SWD功能处理函数
* 参数个数：0
* 参数描述：
* 返 回 值：无
* 修改记录：
*===============================================================
* 日    期          修改人      修改类型
* 2018-10-31       	戴辉发     	创建
==============================================================*/
void swd_process(void)
{
    static uint8_t init_flag = 1;

    if (t_clear_swd_time) return;
    if (init_flag)
    {
        clear_swd_function();
        init_flag = 0;
    }
}

